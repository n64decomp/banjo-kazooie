SECTIONS
{
    . = 0x0; code_code_ROM_START = .; code_code_VRAM = ADDR(.code_code); .code_code 0x8023DA20 : AT(code_code_ROM_START) {
        build/src/core1/code_0.o(.text);
        build/src/core1/code_7C0.o(.text);
        build/src/core1/code_1D00.o(.text);
        build/src/core1/code_2BD0.o(.text);
        build/src/core1/code_2DA0.o(.text);
        build/src/core1/code_2FA0.o(.text);
        build/src/core1/code_31C0.o(.text);
        build/src/core1/code_7090.o(.text);
        build/src/core1/code_72B0.o(.text);
        build/src/core1/code_7F60.o(.text);
        build/src/core1/code_8C50.o(.text);
        build/src/core1/code_9D30.o(.text);
        build/src/core1/code_CE60.o(.text);
        build/src/core1/code_E360.o(.text);
        build/src/core1/code_EAF0.o(.text);
        build/src/core1/code_11AC0.o(.text);
        build/src/core1/code_13680.o(.text);
        build/src/core1/code_13990.o(.text);
        build/src/core1/code_15770.o(.text);
        build/src/core1/code_16A50.o(.text);
        build/src/core1/code_18110.o(.text);
        build/src/core1/code_18210.o(.text);
        build/src/core1/code_18310.o(.text);
        build/src/core1/code_1BE90.o(.text);
        build/src/core1/code_1D5C0.o(.text);
        build/src/core1/code_1D5D0.o(.text);
        build/src/core1/code_1E360.o(.text);
        build/src/core1/code_1E6E0.o(.text);
        build/src/core1/code_1E950.o(.text);
        build/src/core1/code_1F330.o(.text);
        build/src/core1/code_1F9E0.o(.text);
        build/src/core1/code_1FA80.o(.text);
        build/src/core1/code_1FB80.o(.text);
        build/src/core1/code_1FC00.o(.text);
        build/src/core1/code_1FC90.o(.text);
        build/src/core1/code_1FD00.o(.text);
        build/src/core1/code_1FDA0.o(.text);
        build/src/core1/code_21210.o(.text);
        build/src/core1/code_21250.o(.text);
        build/src/core1/code_21960.o(.text);
        build/src/core1/code_219D0.o(.text);
        build/src/core1/code_21A80.o(.text);
        build/src/core1/code_21AB0.o(.text);
        build/src/core1/code_21B50.o(.text);
        build/src/core1/code_21CB0.o(.text);
        build/src/core1/code_22740.o(.text);
        build/src/core1/code_227F0.o(.text);
        build/src/core1/code_22D50.o(.text);
        build/src/core1/code_22DA0.o(.text);
        build/src/core1/code_25360.o(.text);
        build/src/core1/code_25440.o(.text);
        build/src/core1/code_254C0.o(.text);
        build/src/core1/code_25C40.o(.text);
        build/src/core1/code_25E20.o(.text);
        build/src/core1/code_26110.o(.text);
        build/src/core1/code_261C0.o(.text);
        build/src/core1/code_261F0.o(.text);
        build/src/core1/code_26480.o(.text);
        build/src/core1/code_265D0.o(.text);
        build/src/core1/code_26880.o(.text);
        build/src/core1/code_26B30.o(.text);
        build/src/core1/code_26C70.o(.text);
        build/src/core1/code_26D00.o(.text);
        build/src/core1/code_26DB0.o(.text);
        build/src/core1/code_27150.o(.text);
        build/src/core1/code_27200.o(.text);
        build/src/core1/code_27390.o(.text);
        build/src/core1/code_27490.o(.text);
        build/src/core1/code_27940.o(.text);
        build/src/core1/code_27AB0.o(.text);
        build/src/core1/code_27E50.o(.text);
        build/src/core1/code_27F90.o(.text);
        build/src/core1/code_28070.o(.text);
        build/src/core1/code_28440.o(.text);
        build/src/core1/code_284B0.o(.text);
        build/src/core1/code_28810.o(.text);
        build/src/core1/code_289D0.o(.text);
        build/src/core1/code_28A90.o(.text);
        build/src/core1/code_28D00.o(.text);
        build/src/core1/code_28DA0.o(.text);
        build/src/core1/code_28F90.o(.text);
        build/src/core1/code_291F0.o(.text);
        build/src/core1/code_29620.o(.text);
        build/src/core1/code_29870.o(.text);
        build/src/core1/code_29900.o(.text);
        build/src/core1/code_2A3C0.o(.text);
        build/src/core1/code_2A9E0.o(.text);
        build/src/core1/code_2AB20.o(.text);
        build/src/core1/code_2AC50.o(.text);
        build/src/core1/code_2ACE0.o(.text);
        build/src/core1/code_2ADA0.o(.text);
        build/src/core1/code_2C1D0.o(.text);
        build/src/core1/code_2C810.o(.text);
        build/src/core1/code_2C8C0.o(.text);
        build/src/core1/code_2D230.o(.text);
        build/src/core1/code_2D290.o(.text);
        build/src/core1/code_2D2D0.o(.text);
        build/src/core1/code_2DA00.o(.text);
        build/src/core1/code_2DAC0.o(.text);
        build/src/core1/code_2DC70.o(.text);
        build/src/core1/code_2DD70.o(.text);
        build/src/core1/code_2DF50.o(.text);
        build/src/core1/code_2E260.o(.text);
        build/src/core1/code_2EA50.o(.text);
        build/src/core1/code_2EAE0.o(.text);
        build/src/core1/code_2EC50.o(.text);
        build/src/core1/code_2F060.o(.text);
        build/src/core1/code_2F3F0.o(.text);
        build/src/core1/code_2F480.o(.text);
        build/src/core1/code_2F5F0.o(.text);
        build/src/core1/code_301F0.o(.text);
        build/src/core1/code_30300.o(.text);
        build/src/core1/code_31060.o(.text);
        build/src/core1/code_32370.o(.text);
        build/src/core1/code_32F10.o(.text);
        build/src/core1/code_33D60.o(.text);
        build/src/core1/code_33E70.o(.text);
        build/src/core1/code_34930.o(.text);
        build/src/core1/code_349D0.o(.text);
        build/src/core1/code_34A30.o(.text);
        build/src/core1/code_34B20.o(.text);
    }
    . = 0x34BDC; core1_code_34BDC_bin_ROM_START = .; core1_code_34BDC_bin_VRAM = ADDR(.core1_code_34BDC_bin); .core1_code_34BDC_bin 0x802725FC : AT(core1_code_34BDC_bin_ROM_START) {
        build/bin/core1/code_34BDC.o(.data);
    } . = 0x37BF0; code_code_ROM_END = .;
    . = 0x37BF0; code_data_ROM_START = .; code_data_VRAM = ADDR(.code_data); .code_data 0x80275610 : AT(code_data_ROM_START) {
        build/bin/core1/data_37BF0.o(.data);
    } . = 0x3C710; code_data_ROM_END = .;
}
