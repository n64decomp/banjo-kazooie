#ifndef SPLAT_BEGIN_SEG
#ifndef SHIFT
#define SPLAT_BEGIN_SEG(name, start, vram, subalign) \
    . = start;\
    name##_ROM_START = .;\
    name##_VRAM = ADDR(.name);\
    .name vram : AT(name##_ROM_START) subalign {
#else
#define SPLAT_BEGIN_SEG(name, start, vram, subalign) \
    name##_ROM_START = .;\
    name##_VRAM = ADDR(.name);\
    .name vram : AT(name##_ROM_START) subalign {
#endif
#endif

#ifndef SPLAT_END_SEG
#ifndef SHIFT
#define SPLAT_END_SEG(name, end) \
    } \
    . = end;\
    name##_ROM_END = .;
#else
#define SPLAT_END_SEG(name, end) \
    } \
    name##_ROM_END = .;
#endif
#endif

SECTIONS
{
    SPLAT_BEGIN_SEG(code_code, 0x0, 0x80286F90, )
        BUILD_DIR/src/core2/code_0.o(.text);
        BUILD_DIR/src/core2/code_AD0.o(.text);
        BUILD_DIR/src/core2/code_2240.o(.text);
        BUILD_DIR/src/core2/code_2890.o(.text);
        BUILD_DIR/src/core2/code_3480.o(.text);
        BUILD_DIR/src/core2/code_39D0.o(.text);
        BUILD_DIR/src/core2/code_6B30.o(.text);
        BUILD_DIR/src/core2/code_7060.o(.text);
        BUILD_DIR/src/core2/code_9450.o(.text);
        BUILD_DIR/src/core2/code_9900.o(.text);
        BUILD_DIR/src/core2/code_9BD0.o(.text);
        BUILD_DIR/src/core2/code_A600.o(.text);
        BUILD_DIR/src/core2/code_A960.o(.text);
        BUILD_DIR/src/core2/code_AA60.o(.text);
        BUILD_DIR/src/core2/code_B650.o(.text);
        BUILD_DIR/src/core2/code_B850.o(.text);
        BUILD_DIR/src/core2/code_C3F0.o(.text);
        BUILD_DIR/src/core2/code_C4B0.o(.text);
        BUILD_DIR/src/core2/code_D800.o(.text);
        BUILD_DIR/src/core2/code_D9B0.o(.text);
        BUILD_DIR/src/core2/code_DF70.o(.text);
        BUILD_DIR/src/core2/code_E410.o(.text);
        BUILD_DIR/src/core2/code_E910.o(.text);
        BUILD_DIR/src/core2/code_EE40.o(.text);
        BUILD_DIR/src/core2/code_FD60.o(.text);
        BUILD_DIR/src/core2/code_10DA0.o(.text);
        BUILD_DIR/src/core2/code_11040.o(.text);
        BUILD_DIR/src/core2/code_11660.o(.text);
        BUILD_DIR/src/core2/code_117D0.o(.text);
        BUILD_DIR/src/core2/code_11870.o(.text);
        BUILD_DIR/src/core2/code_11DE0.o(.text);
        BUILD_DIR/src/core2/code_126C0.o(.text);
        BUILD_DIR/src/core2/code_12F30.o(.text);
        BUILD_DIR/src/core2/code_13670.o(.text);
        BUILD_DIR/src/core2/code_13780.o(.text);
        BUILD_DIR/src/core2/code_13900.o(.text);
        BUILD_DIR/src/core2/code_13FC0.o(.text);
        BUILD_DIR/src/core2/code_15F20.o(.text);
        BUILD_DIR/src/core2/code_16010.o(.text);
        BUILD_DIR/src/core2/code_16C60.o(.text);
        BUILD_DIR/src/core2/code_171F0.o(.text);
        BUILD_DIR/src/core2/bsBarge.o(.text);
        BUILD_DIR/src/core2/bsBuster.o(.text);
        BUILD_DIR/src/core2/bsBee.o(.text);
        BUILD_DIR/src/core2/bsBeeFly.o(.text);
        BUILD_DIR/src/core2/bsBeeMain.o(.text);
        BUILD_DIR/src/core2/bsEggAss.o(.text);
        BUILD_DIR/src/core2/bsEggHead.o(.text);
        BUILD_DIR/src/core2/bsBFlap.o(.text);
        BUILD_DIR/src/core2/bsBFlip.o(.text);
        BUILD_DIR/src/core2/bsBFly.o(.text);
        BUILD_DIR/src/core2/bsBLongLeg.o(.text);
        BUILD_DIR/src/core2/bsBPeck.o(.text);
        BUILD_DIR/src/core2/bsBShock.o(.text);
        BUILD_DIR/src/core2/bsBSwim.o(.text);
        BUILD_DIR/src/core2/bsBTrot.o(.text);
        BUILD_DIR/src/core2/bsBWhirl.o(.text);
        BUILD_DIR/src/core2/bsCarry.o(.text);
        BUILD_DIR/src/core2/bsClaw.o(.text);
        BUILD_DIR/src/core2/bsClimb.o(.text);
        BUILD_DIR/src/core2/bsCroc.o(.text);
        BUILD_DIR/src/core2/bsCrouch.o(.text);
        BUILD_DIR/src/core2/bsDie.o(.text);
        BUILD_DIR/src/core2/bsDrOne.o(.text);
        BUILD_DIR/src/core2/code_27550.o(.text);
        BUILD_DIR/src/core2/bsDrOneToGo.o(.text);
        BUILD_DIR/src/core2/code_27F40.o(.text);
        BUILD_DIR/src/core2/code_28220.o(.text);
        BUILD_DIR/src/core2/code_28810.o(.text);
        BUILD_DIR/src/core2/bsJig.o(.text);
        BUILD_DIR/src/core2/bsJump.o(.text);
        BUILD_DIR/src/core2/bsOw.o(.text);
        BUILD_DIR/src/core2/bsPumpkin.o(.text);
        BUILD_DIR/src/core2/bsRebound.o(.text);
        BUILD_DIR/src/core2/bsRest.o(.text);
        BUILD_DIR/src/core2/code_2CF90.o(.text);
        BUILD_DIR/src/core2/bsSlide.o(.text);
        BUILD_DIR/src/core2/code_2D5E0.o(.text);
        BUILD_DIR/src/core2/bsStand.o(.text);
        BUILD_DIR/src/core2/bsSwim.o(.text);
        BUILD_DIR/src/core2/bsSurf.o(.text);
        BUILD_DIR/src/core2/bsTalk.o(.text);
        BUILD_DIR/src/core2/bsTimeout.o(.text);
        BUILD_DIR/src/core2/bsThrow.o(.text);
        BUILD_DIR/src/core2/bsTurn.o(.text);
        BUILD_DIR/src/core2/bsTwirl.o(.text);
        BUILD_DIR/src/core2/code_329F0.o(.text);
        BUILD_DIR/src/core2/code_32DB0.o(.text);
        BUILD_DIR/src/core2/code_33250.o(.text);
        BUILD_DIR/src/core2/code_33AB0.o(.text);
        BUILD_DIR/src/core2/code_33C30.o(.text);
        BUILD_DIR/src/core2/code_33D40.o(.text);
        BUILD_DIR/src/core2/code_33F90.o(.text);
        BUILD_DIR/src/core2/code_34790.o(.text);
        BUILD_DIR/src/core2/code_35520.o(.text);
        BUILD_DIR/src/core2/code_356B0.o(.text);
        BUILD_DIR/src/core2/code_379B0.o(.text);
        BUILD_DIR/src/core2/code_37CD0.o(.text);
        BUILD_DIR/src/core2/code_37E50.o(.text);
        BUILD_DIR/src/core2/code_38150.o(.text);
        BUILD_DIR/src/core2/code_382E0.o(.text);
        BUILD_DIR/src/core2/code_38460.o(.text);
        BUILD_DIR/src/core2/code_38630.o(.text);
        BUILD_DIR/src/core2/code_388E0.o(.text);
        BUILD_DIR/src/core2/code_38F40.o(.text);
        BUILD_DIR/src/core2/code_39190.o(.text);
        BUILD_DIR/src/core2/code_39A10.o(.text);
        BUILD_DIR/src/core2/code_39EF0.o(.text);
        BUILD_DIR/src/core2/code_3AE10.o(.text);
        BUILD_DIR/src/core2/code_3B2C0.o(.text);
        BUILD_DIR/src/core2/code_3B5C0.o(.text);
        BUILD_DIR/src/core2/chGameSelect.o(.text);
        BUILD_DIR/src/core2/code_3EAD0.o(.text);
        BUILD_DIR/src/core2/code_3ECE0.o(.text);
        BUILD_DIR/src/core2/code_3EEF0.o(.text);
        BUILD_DIR/src/core2/code_400F0.o(.text);
        BUILD_DIR/src/core2/code_40AA0.o(.text);
        BUILD_DIR/src/core2/code_41460.o(.text);
        BUILD_DIR/src/core2/code_41FB0.o(.text);
        BUILD_DIR/src/core2/code_42CA0.o(.text);
        BUILD_DIR/src/core2/code_43250.o(.text);
        BUILD_DIR/src/core2/code_43390.o(.text);
        BUILD_DIR/src/core2/code_43A40.o(.text);
        BUILD_DIR/src/core2/code_43CD0.o(.text);
        BUILD_DIR/src/core2/code_440B0.o(.text);
        BUILD_DIR/src/core2/code_45310.o(.text);
        BUILD_DIR/src/core2/code_46BC0.o(.text);
        BUILD_DIR/src/core2/code_47850.o(.text);
        BUILD_DIR/src/core2/code_47BD0.o(.text);
        BUILD_DIR/src/core2/code_49570.o(.text);
        BUILD_DIR/src/core2/code_49A70.o(.text);
        BUILD_DIR/src/core2/code_4A420.o(.text);
        BUILD_DIR/src/core2/code_4BD70.o(.text);
        BUILD_DIR/src/core2/code_4BE10.o(.text);
        BUILD_DIR/src/core2/code_4C020.o(.text);
        BUILD_DIR/src/core2/code_4FB80.o(.text);
        BUILD_DIR/src/core2/chBadShad.o(.text);
        BUILD_DIR/src/core2/code_50490.o(.text);
        BUILD_DIR/src/core2/chClimbBase.o(.text);
        BUILD_DIR/src/core2/code_517A0.o(.text);
        BUILD_DIR/src/core2/code_51950.o(.text);
        BUILD_DIR/src/core2/code_51C90.o(.text);
        BUILD_DIR/src/core2/code_53A10.o(.text);
        BUILD_DIR/src/core2/code_53C10.o(.text);
        BUILD_DIR/src/core2/code_55180.o(.text);
        BUILD_DIR/src/core2/code_556C0.o(.text);
        BUILD_DIR/src/core2/code_55850.o(.text);
        BUILD_DIR/src/core2/code_55A90.o(.text);
        BUILD_DIR/src/core2/code_55BC0.o(.text);
        BUILD_DIR/src/core2/code_57C70.o(.text);
        BUILD_DIR/src/core2/code_581D0.o(.text);
        BUILD_DIR/src/core2/code_584D0.o(.text);
        BUILD_DIR/src/core2/code_599E0.o(.text);
        BUILD_DIR/src/core2/code_59A80.o(.text);
        BUILD_DIR/src/core2/code_59D40.o(.text);
        BUILD_DIR/src/core2/code_5BD90.o(.text);
        BUILD_DIR/src/core2/code_5BEB0.o(.text);
        BUILD_DIR/src/core2/code_5DBC0.o(.text);
        BUILD_DIR/src/core2/code_5FD80.o(.text);
        BUILD_DIR/src/core2/code_5FD90.o(.text);
        BUILD_DIR/src/core2/code_62FD0.o(.text);
        BUILD_DIR/src/core2/code_630D0.o(.text);
        BUILD_DIR/src/core2/code_63410.o(.text);
        BUILD_DIR/src/core2/code_63690.o(.text);
        BUILD_DIR/src/core2/code_637D0.o(.text);
        BUILD_DIR/src/core2/code_654C0.o(.text);
        BUILD_DIR/src/core2/code_66490.o(.text);
        BUILD_DIR/src/core2/code_66AB0.o(.text);
        BUILD_DIR/src/core2/gcBound.o(.text);
        BUILD_DIR/src/core2/code_67650.o(.text);
        BUILD_DIR/src/core2/code_69F60.o(.text);
        BUILD_DIR/src/core2/code_6A4B0.o(.text);
        BUILD_DIR/src/core2/code_6AEF0.o(.text);
        BUILD_DIR/src/core2/code_6CD20.o(.text);
        BUILD_DIR/src/core2/code_6CEC0.o(.text);
        BUILD_DIR/src/core2/code_6D270.o(.text);
        BUILD_DIR/src/core2/code_6DA30.o(.text);
        BUILD_DIR/src/core2/code_70C30.o(.text);
        BUILD_DIR/src/core2/code_70F20.o(.text);
        BUILD_DIR/src/core2/code_71820.o(.text);
        BUILD_DIR/src/core2/code_72060.o(.text);
        BUILD_DIR/src/core2/code_72B10.o(.text);
        BUILD_DIR/src/core2/code_74090.o(.text);
        BUILD_DIR/src/core2/code_74290.o(.text);
        BUILD_DIR/src/core2/code_74420.o(.text);
        BUILD_DIR/src/core2/code_75480.o(.text);
        BUILD_DIR/src/core2/code_75930.o(.text);
        BUILD_DIR/src/core2/code_75E90.o(.text);
        BUILD_DIR/src/core2/code_76390.o(.text);
        BUILD_DIR/src/core2/code_76D90.o(.text);
        BUILD_DIR/src/core2/code_77E50.o(.text);
        BUILD_DIR/src/core2/code_78100.o(.text);
        BUILD_DIR/src/core2/code_78E50.o(.text);
        BUILD_DIR/src/core2/code_79830.o(.text);
        BUILD_DIR/src/core2/code_7AF80.o(.text);
        BUILD_DIR/src/core2/code_83D70.o(.text);
        BUILD_DIR/src/core2/code_840D0.o(.text);
        BUILD_DIR/src/core2/gcTransition.o(.text);
        BUILD_DIR/src/core2/code_851D0.o(.text);
        BUILD_DIR/src/core2/code_857B0.o(.text);
        BUILD_DIR/src/core2/code_85800.o(.text);
        BUILD_DIR/src/core2/gcPauseMenu.o(.text);
        BUILD_DIR/src/core2/code_8DC20.o(.text);
        BUILD_DIR/src/core2/gcZoombox.o(.text);
        BUILD_DIR/src/core2/code_91E10.o(.text);
        BUILD_DIR/src/core2/code_935F0.o(.text);
        BUILD_DIR/src/core2/code_93C10.o(.text);
        BUILD_DIR/src/core2/code_94620.o(.text);
        BUILD_DIR/src/core2/code_99860.o(.text);
        BUILD_DIR/src/core2/code_999A0.o(.text);
        BUILD_DIR/src/core2/code_99F80.o(.text);
        BUILD_DIR/src/core2/code_9A320.o(.text);
        BUILD_DIR/src/core2/code_9A580.o(.text);
        BUILD_DIR/src/core2/code_9A9D0.o(.text);
        BUILD_DIR/src/core2/code_9AD00.o(.text);
        BUILD_DIR/src/core2/code_9B180.o(.text);
        BUILD_DIR/src/core2/code_9B650.o(.text);
        BUILD_DIR/src/core2/code_9C170.o(.text);
        BUILD_DIR/src/core2/code_9D760.o(.text);
        BUILD_DIR/src/core2/code_9E370.o(.text);
        BUILD_DIR/src/core2/code_A4D00.o(.text);
        BUILD_DIR/src/core2/code_ABC00.o(.text);
        BUILD_DIR/src/core2/code_AC520.o(.text);
        BUILD_DIR/src/core2/code_AD5B0.o(.text);
        BUILD_DIR/src/core2/code_AE290.o(.text);
        BUILD_DIR/src/core2/code_AE5D0.o(.text);
        BUILD_DIR/src/core2/code_B1400.o(.text);
        BUILD_DIR/src/core2/code_B3A80.o(.text);
        BUILD_DIR/src/core2/code_B5040.o(.text);
        BUILD_DIR/src/core2/code_B5E00.o(.text);
        BUILD_DIR/src/core2/code_B6640.o(.text);
        BUILD_DIR/src/core2/string.o(.text);
        BUILD_DIR/src/core2/code_B6C60.o(.text);
        BUILD_DIR/src/core2/code_B6CE0.o(.text);
        BUILD_DIR/src/core2/code_B7B20.o(.text);
        BUILD_DIR/src/core2/code_B7F40.o(.text);
        BUILD_DIR/src/core2/code_B8020.o(.text);
        BUILD_DIR/src/core2/code_B8070.o(.text);
        BUILD_DIR/src/core2/code_B9090.o(.text);
        BUILD_DIR/src/core2/code_B9770.o(.text);
        BUILD_DIR/src/core2/code_BD100.o(.text);
        BUILD_DIR/src/core2/code_BE2C0.o(.text);
        BUILD_DIR/src/core2/code_BEF20.o(.text);
        BUILD_DIR/src/core2/code_C0CF0.o(.text);
        BUILD_DIR/src/core2/code_C2C20.o(.text);
        BUILD_DIR/src/core2/code_C31A0.o(.text);
        BUILD_DIR/src/core2/code_C3400.o(.text);
        BUILD_DIR/src/core2/code_C3A40.o(.text);
        BUILD_DIR/src/core2/code_C3B20.o(.text);
        BUILD_DIR/src/core2/code_C4320.o(.text);
        BUILD_DIR/src/core2/code_C4F40.o(.text);
        BUILD_DIR/src/core2/code_C5440.o(.text);
        BUILD_DIR/src/core2/code_C5AF0.o(.text);
        BUILD_DIR/src/core2/code_C5CC0.o(.text);
        BUILD_DIR/src/core2/code_C5F00.o(.text);
        BUILD_DIR/src/core2/code_C61C0.o(.text);
        BUILD_DIR/src/core2/code_C62B0.o(.text);
        BUILD_DIR/src/core2/code_C76D0.o(.text);
        BUILD_DIR/src/core2/code_C7CC0.o(.text);
        BUILD_DIR/src/core2/code_C8230.o(.text);
        BUILD_DIR/src/core2/code_C8360.o(.text);
        BUILD_DIR/src/core2/code_C8490.o(.text);
        BUILD_DIR/src/core2/code_C8760.o(.text);
        BUILD_DIR/src/core2/code_C89C0.o(.text);
        BUILD_DIR/src/core2/code_C97F0.o(.text);
        BUILD_DIR/src/core2/code_C9E70.o(.text);
        BUILD_DIR/src/core2/code_C9F00.o(.text);
        BUILD_DIR/src/core2/code_CB050.o(.text);
        BUILD_DIR/src/core2/code_CB610.o(.text);
        BUILD_DIR/src/core2/code_CBBF0.o(.text);
        BUILD_DIR/src/core2/code_CBD10.o(.text);
        BUILD_DIR/src/core2/code_CC1E0.o(.text);
        BUILD_DIR/src/core2/code_CD0A0.o(.text);
        BUILD_DIR/src/core2/code_CD3F0.o(.text);
        BUILD_DIR/src/core2/code_CECD0.o(.text);
        BUILD_DIR/src/core2/code_CF3E0.o(.text);
        BUILD_DIR/src/core2/code_CF7E0.o(.text);
        BUILD_DIR/src/core2/code_CFA60.o(.text);
        BUILD_DIR/src/core2/code_D2500.o(.text);
        BUILD_DIR/src/core2/code_D2E10.o(.text);
        BUILD_DIR/src/core2/code_D4050.o(.text);
        BUILD_DIR/src/core2/code_D50F0.o(.text);
        BUILD_DIR/src/core2/code_D5D10.o(.text);
        BUILD_DIR/src/core2/code_D5FD0.o(.text);
        BUILD_DIR/src/core2/code_D6180.o(.text);
        BUILD_DIR/src/core2/code_D6600.o(.text);
        BUILD_DIR/src/core2/code_D7D10.o(.text);
        BUILD_DIR/src/core2/code_D89E0.o(.text);
        BUILD_DIR/src/core2/code_D9DA0.o(.text);
        BUILD_DIR/src/core2/code_DA3A0.o(.text);
        BUILD_DIR/src/core2/code_DA760.o(.text);
        BUILD_DIR/src/core2/code_DB010.o(.text);
    SPLAT_END_SEG(code_code, 0xDC600)
    
    SPLAT_BEGIN_SEG(code_data, 0xDC600, 0x80363590, )
        BUILD_DIR/bin/core2/data_DC600.o(.data);
    SPLAT_END_SEG(code_data, 0xF2C00)
}
